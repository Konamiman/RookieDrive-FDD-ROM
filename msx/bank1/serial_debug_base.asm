;                 SC16C550B external reset conditions
;
;	Register	Reset sate
;	-------------------------------------
;		IER		IER[7:0] = 0
;		ISR		ISR[7:1] = 0; ISR[0] = 1
;		LCR		LCR[7:0] = 0
;		MCR		MCR[7:0] = 0
;		LSR		LSR[7] = 0; LSR[6:5] = 1; LSR[4:0] = 0
;		MSR		MSR[7:4] = input signals; MSR[3:0] = 0
;		FCR		FCR[7:0] = 0

RHR	equ	#30	;Receive Holding Register (RHR)
THR	equ	#30	; Transmit Holding Register (THR)
IER	equ	#31	;Interrupt Enable Register (IER)
;
; 	Default value: 00
;
;	Bit	Symbol 		Description
; -------------------------------------------------------------
;	7:4	IER[7:4] 	not used
;	3	IER[3]		Modem Status Interrupt.
;					logic 0 = disable the modem status register interrupt (normal default condition)
;					logic 1 = enable the modem status register interrupt
;	2	IER[2]		Receive Line Status interrupt. This interrupt will be issued whenever a fully
;					assembled receive character is transferred from RSR to the RHR/FIFO, that is, data ready, LSR[0].
;					logic 0 = disable the receiver line status interrupt (normal default condition)
;					logic 1 = enable the receiver line status interrupt
;	1	IER[1]		Transmit Holding Register interrupt. This interrupt will be issued whenever the
;					THR is empty, and is associated with LSR[1].
;					logic 0 = disable the transmitter empty interrupt (normal default condition)
;					logic 1 = enable the transmitter empty interrupt
;	0	IER[0]		Receive Holding Register interrupt. This interrupt will be issued when the FIFO
;					has reached the programmed trigger level, or is cleared when the FIFO drops
;					below the trigger level in the FIFO mode of operation.
;					logic 0 = disable the receiver ready interrupt (normal default condition)
;					logic 1 = enable the receiver ready interrupt

FCR	equ	#32	;FIFO Control Register (FCR)
;					This register is used to enable the FIFOs, clear the FIFOs, 
;					set the receive FIFO trigger levels, and select the DMA mode.
;
;	Default value: 00
;
;	Bit	Symbol 		Description
; -------------------------------------------------------------
;	7	FCR[7]		RX trigger (MSB)
;	6	FCR[6]		RX trigger (LSB)
;	5	FCR[5]		not used, set to 0
;	4	FCR[4]		not used, set to 0
;	3	FCR[3]		DMA mode select
;	2	FCR[2]		TX FIFO reset
;	1	FCR[1]		RX FIFO reset
;	0	FCR[0]		FIFO enable.
;					logic 0 = disable the transmit and receive FIFO 
;					(normal default condition)
;					logic 1 = enable the transmit and receive FIFO. 
;					This bit must be a b
;					or they will not be programmed.

ISR	equ	#32	; Interrupt Status Register (ISR)
;
;	Default value: 01
;
;	Priority	ISR[3]	ISR[2]	ISR[1]	ISR[0]
;		x			0		0		0		1	No interrupt pending
;		1			0		1		1		0	LSR (Receiver Line Status Register)
;		2			0		1		0		0	RXRDY (Received Data Ready)
;		2			0		1		0		0	RXRDY (Receive Data time out)
;		3			0		0		1		0	TXRDY ( Transmitter Holding Register Empty)
;		4			0		0		0		0	MSR (Modem Status Register)

LCR	equ	#33	; Line Control Register (LCR)
;
;		LCR[1]	LCR[0]	Word length
;		----------------------------
;			0		0		5
;			0		1		6
;			1		0		7
;			1		1		8
;
;		LCR[2]	Word length		Stop bit length (Bit time(s))
;		-----------------------------------------------------
;			0		5,6,7,8			1
;			1			5			1-1/2
;			1		6,7,8			2
;
;		LCR[5]	LCR[4]	LCR[4]	Parity selection
;		----------------------------------------
;			X		X		0		no parity
;			0		0		1		odd parity
;			0		1		1		even parity
;			1		0		1		fo rced parity b
;			1		1		1		fo rced parity b
;
;		LCR[3]	Parity enable. 	Parity or no parity can be selected via this bit.
;								logic 0 = no parity (normal default condition)
;								logic 1 = a parity bit is generated during the transmission, receiver checks
;								the data and parity for transmission errors
;
;		LCR[4] Even parity. 	If the parity bit is enabled with LCR[3] set to a logic 1, LCR[4]
;								selects the even or odd parity format.
;								logic 0 = odd parity is generated by forcing an odd number of logic 1s in the
;								transmitted data. The receiver must be programmed to check the same
;								format (normal default condition).
;								logic 1 = even parity is generated by forcing an even number of logic 1s in
;								the transmitted data. The receiver must be programmed to check the same
;								format.
;
;		LCR[5] Set parity.		If the parity bit is enabled, LCR[5] selects the forced parity format.
;								Programs the parity conditions (see Table 16).
;								logic 0 = parity is not forced (normal default condition)
;								LCR[5] = logic 1 and LCR[4] = logic 0: parity bit is forced to a logical 1 for
;								the transmit and receive data
;								LCR[5] = logic 1 and LCR[4] = logic 1: parity bit is forced to a logical 0 for
;								the transmit and receive data
;
;		LCR[6] Set break.		When enabled, the Break control bit causes a break condition to
;								be transmitted (the TX output is forced to a logic 0 state). This condition exists
;								until disabled by setting LCR[6] to a logic 0.
;								logic 0 = no TX break condition (normal default condition)
;								logic 1 = forces the transmitter output (TX) to a logic 0 for alerting the
;								remote receiver to a line break condition
;
;		LCR[7] Divisor latch enable. The internal baud rate counter latch and Enhance
;								Feature mode enable.
;								logic 0 = divisor latch disabled (normal default condition)
;								logic 1 = divisor latch and enhanced feature register enabled

DLL	equ	#30	;
DLM	equ	#31	;

MCR	equ	#34	; Modem Control Register (MCR)
;
;	Bit	Symbol 		Description
; -------------------------------------------------------------
;	7	MCR[7]		reserved; set to b
;	6	MCR[6]		reserved; set to b
;	5	MCR[5]		Auto flow control enable.
;	4	MCR[4]		Loopback. Enable the local loopback mode (diagnostics). In this mode the
;					transmitter output (TX) and the receiver input (RX), /CTS, /DSR, /DCD, and
;					/RI are disconnected from the SC16C550B I/O pins. Internally the modem
;					data and control pins are connected into a loopback data configuration
;					(see Figure 11). In this mode, the receiver and transmitter interrupts
;					remain fully operational. The Modem Control Interrupts are also
;					operational, but the interruptsb
;					of the Modem Control. Interrupts continue to be controlled by the IER
;					register.
;					logic 0 = disable loopback mode (normal default condition)
;					logic 1 = enable local loopback mode (diagnostics)
;
;	3	MCR[3]		/OUT2. Used to control the modem /DCD signal in the loopback mode.
;					logic 0 = /OUT2 is at logic 1. In the loopback mode, sets /OUT2 (/DCD)
;					internally to a logic 1.
;					logic 1 = /OUT2 is at logic 0. In the loopback mode, sets /OUT2 (/DCD)
;					internally to a logic 0.
;
;	2	MCR[2]		/OUT1. This bit is used in the Loopback mode only. In the loopback mode,
;					this bit is used to write the state of the modem RI interface signal via
;					/OUT1.
;
;	1	MCR[1]		/RTS
;					logic 0 = force /RTS output to a logic 1 (normal default condition)
;					logic 1 = force /RTS output to a logic 0
;
;	0	MCR[0]		/DTR
;					logic 0 = force /DTR output to a logic 1 (normal default condition)
;					logic 1 = force /DTR output to a logic 0

LSR	equ	#35	; Line Status Register (LSR)
;
;	This register provides the status of data transfers between the SC16C550B and the CPU	
;
;	Bit	Symbol 		Description
; -------------------------------------------------------------
;	7	LSR[7] 		FIFO data error.
;					logic 0 = no error (normal default condition)
;					logic 1 = at least one parity error, framing error or break indication is in the
;					current FIFO data. This bit is cleared when LSR register is read. 
;	6	LSR[6]		THR and TSR empty. This bit is the Transmit Empty indicator. This bit is set to a
;					logic 1 whenever the transmit holding register and the transmit shift register are
;					both empty. It is reset to logic 0 whenever either the THR or TSR contains a data
;					character. In the FIFO mode, this bit is set to b
;					transmit shift register are both empty.
;	5	LSR[5]		THR empty. This bit is the Transmit Holding Register Empty indicator. This bit
;					indicates that the UART is ready to accept a new character for transmission. In
;					addition, this bit causes the UART to issue an interrupt to CPU when the THR
;					interrupt enable is set. The THR bit is set to a logic 1 when a character is
;					transferred from the transmit holding register into the transmitter shift register.
;					The bit is reset to a logic 0 concurrently with the loading of the transmitter holding
;					register by the CPU. In the FIFO mode, this bit is set when the transmit FIFO is
;					empty; it is cleared when at least 1 byte is written to the transmit FIFO.
;
;	4	LSR[4] 		Break interrupt.
;					logic 0 = no break condition (normal default condition)
;					logic 1 = the receiver received a break signal (RX was a logic 0 for one
;					character frame time). In the FIFO mode, only one break character is loaded
;					into the FIFO.
;
;	3	LSR[3]		Framing error.
;					logic 0 = no framing error (normal default condition)
;					logic 1 = framing error. The receive character did not have a valid stop bit(s). In
;					the FIFO mode, this error is associated with the character at the top of the
;					FIFO.
;
;	2	LSR[2]		Parity error.
;					logic 0 = no parity error (normal default condition)
;					logic 1 = parity error. The receive character does not have correct parity
;					information and is suspect. In the FIFO mode, this error is associated with the
;					character at the top of the FIFO.
;
;	1	LSR[1]		Overrun error.
;					logic 0 = no overrun error (normal default condition)
;					logic 1 = overrun error. A data overrun error occurred in the receive shift
;					register. This happens when additional data arrives while the FIFO is full. In
;					this case, the previous data in the shift register is overwritten. Note that under
;					this condition, the data byte in the receive shift register is not transferred into
;					the FIFO, therefore the data in the FIFO is not corrupted by the error.
;
;	0	LSR[0]		Receive data ready.
;					logic 0 = no data in receive holding register or FIFO (normal default condition)
;					logic 1 = data has been received and is saved in the receive holding register or
;					FIFO

MSR	equ	#36	;       Modem Status Register (MSR)
;
;	This register provides the current state of the control interface signals from the modem, or
;	other peripheral device to which the SC16C550B is connected. Four bits of this register
;	are used to indicate the changed information. These bits are set to a logic 1 whenever a
; 	control input from the modem changes state. These bits are set to a logic 0 whenever the
;	CPU reads this register.
;
;	Bit	Symbol 		Description
; -------------------------------------------------------------
;	7	MSR[7] 		Data Carrier Detect.
;					DCD (active HIGH, logical 1). Normally this bit is the
;					complement of the /DCD input. In the loopback mode this bit is equivalent to
;					the OUT2 bit in the MCR register.
;
;	6	MSR[6]		Ring Indicator. 
;					RI (active HIGH, logical 1). Normally this bit is the
;					complement of the /RI input. In the loopback mode this bit is equivalent to the
;					OUT1 bit in the MCR register.
;
;	5	MSR[5]		Data Set Ready.
;					DSR (active HIGH, logical 1). Normally this bit is the
;					complement of the DSR input. In loopback mode this bit is equivalent to the
;					DTR bit in the MCR register.
;
;	4	MSR[4]		Clear To Send.
;					CTS. /CTS functions as hardware flow control signal input if it
;					is enabled via MCR[5]. The transmit holding register flow control is
;					enabled/disabled by MSR[4]. Flow control (when enabled) allows starting and
;					stopping the transmissions based on the external modem /CTS signal. A logic
;					1 at the /CTS pin will stop SC16C550B transmissions as soon as current
;					character has finished transmission. Normally MSR[4] is the complement of
;					the /CTS input. However, in the loopback mode, this bit is equivalent to the
;					RTS bit in the MCR register.
;
;	3	MSR[3]		Delta /DCD[1]
;					logic 0 = no DCD change (normal default condition)
;					logic 1 = the DCD input to the SC16C550B has changed state since the last
;					time it was read. A modem Status Interrupt will be generated.
;
;	2	MSR[2]		Delta /RI[1]
;					logic 0 = no RI change (normal default condition).
;					logic 1 = the RI input to the SC16C550B has changed from a logic 0 to a
;					logic 1. A modem Status Interrupt will be generated.
;
;	1	MSR[1]		Delta /DSR[1]
;					logic 0 = no DSR change (normal default condition)
;					logic 1 = the DSR input to the SC16C550B has changed state since the last
;					time it was read. A modem Status Interrupt will be generated.
;
;	0	MSR[0]		Delta /CTS[1]
;					logic 0 = no CTS change (normal default condition)
;                 log ic 1 = the CTS input to the SC16C550B has changed state since the last
;					time it was read. A modem Status Interrupt will be generated.
;
;					[1] Whenever any MSR bit 0:3 is set to logic 1, a Modem Status Interrupt will be generated.
;

SPR	equ	#37	; Scratchpad Register (SPR)
					; The SC16C550B provides a temporary data register to store 8 bits of user information.


;BDOS	equ	00005h
;CHPUT	equ	#00A2

    if 0

	org	100h

main:
		call initUART
		;ld hl, test_str
		;call sendstring
	;call	DUMP_ROM_RAM
	;jp receiveloop
		;ret

receiveloop:
		in a,(LSR)
		bit 0,a
		jp z, receiveloop
		in a,(RHR)
		ld e,a
		call printchar
		jp receiveloop

printchar:
		ld	c,2
		call	BDOS		; Print character
		ret

    endif


initUART:
		call EnableFIFO		; Activate FIFIO buffer
		call SetPrams		; set 8,N,1
		call SetAutoFlowOn	; Enable autoflow conrtol
	    ld	b, 120	; 10=230400;  120=19200;  20 = 115200
		call setdivisor		; Set UART speed
		ret

EnableFIFO:
		ld a,1 				; FCR[0] = 1 enable FIFO
		out (FCR),a
		xor a
		out (IER),a 		; no interrupts , Poll mode
		ret

SetPrams:
		ld a, 2+1			; set 8,N,1
		out (LCR), a		; word lentg 8, 1 stop bit, no parity 
		ret

SetAutoFlowOn:
		push af
		ld a, 32			; MCR[5] = 1 enable autoflow control  / auto RTS and CTS
		out (MCR), a
		pop af
		ret

; setdivisor
; pasar el valor en B
; en el prototipo el cristal es de 36.864Mhz, valores comunos del divisor: 
;	9600 => 240
;	19200 => 120
;	38400 => 60
;	57600 => 40
;	115200 => 20
;	230400 => 10
setdivisor:
		in a,(LCR) 			; Backup LCR
		push af
		ld a,128			; enable special registers
		out (LCR),a
		xor a
		out (DLM),a			; MSB value of divider register
		ld a,b
	out	(DLL),a	; LSB value of divider register
		pop af
		out (LCR),a			; Restore old value
		ret


;
; send string using serial port
; 
; HL = pointer to the null terminated string
;
sendstring:
	push af
	push hl
	call sendstring2
	pop hl
	pop af
	ret

sendstring2:
		in a,(LSR)
		and 32				; LSR[5]
		jr z,sendstring2 	; wait to buffer empty
		ld a,(hl)
		or a
		ret z
sendcharloop:
		out (THR),a
		inc hl
		jr sendstring2

sendchar:
		push af
waitforsendchar:
		in a,(LSR)
		and 32					; LSR[5]
		jp z, waitforsendchar	; wait to buffer empty
		pop af
		out (THR),a
		ret


	if 0

DUMP_ROM_RAM:
	ld	hl,#0000
	ld	de,#100
		jp dumpmem

;
; Dump mem
; 
; HL = start address
; DE = lenght
;
dumpmem:
		di
		push hl
		ld hl, dump_str
		call sendstring
		pop hl
		ex de,hl

		xor a
		add hl, hl
		rla
		add hl, hl
		rla
		add hl, hl
		rla
		ld l, h
		ld h, a

		ex de,hl
dumpmemloop:

		push hl
	ld	hl,newline
		call sendstring
		pop hl

		xor a
		call sendhex
		ld a,h
		call sendhex
		ld a,l
		call sendhex
		ld a,32
		call sendchar
		ld b,32		;wide 32

innerloop:
		ld a,32
		call sendchar
		ld a,(hl)
		call sendhex
		inc hl
		djnz innerloop
		dec de
		ld a,d
		or e
		jp nz,dumpmemloop
		ei
		ret

	endif


;
; SendtHex
;
;	Envia el valor de A
;
sendhex:
		push	af
		push	de
		push 	bc

			;call 	NumToHex
NumToHex:
		ld	c, a	; a = number to convert
	call	Num1
	ld	d, a
	ld	a, c
	call	Num2
		ld	e, a
		ld	a, d
		call	sendchar
		ld	a,e
		call	sendchar
		pop		bc
		pop		de
		pop 	af
		ret

Num1
		rra
		rra
		rra
		rra
Num2
	or	#F0
		daa
	add	a, #A0
	adc	a, #40	; Ascii hex at this point (0 to F)
		ret

    if 0
test_str		db "Si usted puede leer esto, es que no necesita gafas",10,13,0
dump_str		db "Dumping memory",13,10, "Offset  00 01 02 03 04 05 06 07 08 09 0A 0B 0C 0D 0E 0F 10 11 12 13 14 15 16 17 18 19 1A 1B 1C 1D 1E 1F", 13,10,0
newline:	db	13,10,0
    endif

